VERSION ""

NS_ :

BS_:

BU_: ACTUATOR_ECU ENGINE_ECU

BO_ 32 Actuator_msg: 4 Vector__XXX
 SG_ ActSteps_sgn : 8|16@1- (1,0) [0|0] "Steps" Vector__XXX
 SG_ ActPresence_sgn : 0|1@1- (1,0) [0|0] "" Vector__XXX

BO_ 16 Engine_msg: 4 Vector__XXX
 SG_ EngineRPM_sgn : 8|16@1+ (1,0) [0|0] "RPM" Vector__XXX
 SG_ EnginePrecense_sgn : 0|1@1- (1,0) [0|0] "" Vector__XXX
