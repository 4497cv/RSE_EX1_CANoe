/*@!Encoding:1252*/
includes
{
  
}

variables
{
  msTimer timer10ms;
  message Engine_msg EngineMSG;
}

on start
{
  setTimer(timer10ms, 10);
  EngineMSG.EnginePrecense_sgn = 0;
}

on timer timer10ms
{
  if(1 ==  EngineMSG.EnginePrecense_sgn)
  {
    EngineMSG.EnginePrecense_sgn = 0;
  }
  else
  {
    EngineMSG.EnginePrecense_sgn = 1;
  }
  
  setTimer(timer10ms,10);    
  output(EngineMSG);
}

